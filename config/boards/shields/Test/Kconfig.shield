## config/boards/shields/Test/Kconfig.shield
```kconfig
config SHIELD_KeyballBLE-M_R
    def_bool $(shields_list_contains,KeyballBLE-M_R)

config SHIELD_KeyballBLE-M_L
    def_bool $(shields_list_contains,KeyballBLE-M_L)
```
